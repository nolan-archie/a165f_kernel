## KernelSU/kernel/Kconfig
```kconfig
menu "KernelSU"

config KSU
	tristate "KernelSU function support"
	depends on KPROBES && EXT4_FS
	default y
	help
	  Enable kernel-level root privileges on Android System.
	  Requires CONFIG_KPROBES for kernel hooking support.
	  Requires CONFIG_EXT4_FS for `ext4_unregister_sysfs`.
	  To compile as a module, choose M here: the
	  module will be called kernelsu.

config KSU_DEBUG
	bool "KernelSU debug mode"
	depends on KSU
	default n
	help
	  Enable KernelSU debug mode.

choice
	prompt "KernelSU hooks"
	default KSU_NONE_HOOK
	help
	  KernelSU core hook mode.

config KSU_MANUAL_HOOK
	bool "KernelSU manual hook mode"
	depends on KSU && KSU != m
	help
	  Enable manual hook support.

config KSU_SYSCALL_HOOK
	bool "KernelSU syscall hook mode"
	depends on KSU
	depends on KPROBES && KRETPROBES && HAVE_SYSCALL_TRACEPOINTS
	help
	  Enable kprobe/kretprobe and tracepoint based hooks for KernelSU.

config KSU_NONE_HOOK
	bool "KernelSU none hook mode"
	depends on KSU && KSU != m && KSU_SUSFS
	help
	  Use the inline SUSFS integration path.

endchoice

config KSU_MANUAL_SU
	bool "Use manual su"
	depends on KSU
	default y
	help
	  Use manual su and authorize the corresponding command line and application via prctl

menu "KernelSU - SUSFS"

config KSU_SUSFS
	bool "KernelSU addon - SUSFS"
	depends on KSU
	depends on THREAD_INFO_IN_TASK
	default n
	help
	  Patch and enable SUSFS support alongside KernelSU.

config KSU_SUSFS_SUS_PATH
	bool "Enable suspicious path hiding"
	depends on KSU_SUSFS
	default y
	help
	  Hide user-defined paths and their subpaths from various lookups.

config KSU_SUSFS_SUS_MOUNT
	bool "Enable suspicious mount hiding"
	depends on KSU_SUSFS
	default y
	help
	  Hide SUSFS-managed mounts from non-su processes.

config KSU_SUSFS_SUS_KSTAT
	bool "Enable suspicious kstat spoofing"
	depends on KSU_SUSFS
	default y
	help
	  Spoof stat metadata for selected paths.

config KSU_SUSFS_SPOOF_UNAME
	bool "Enable uname spoofing"
	depends on KSU_SUSFS
	default y
	help
	  Spoof uname output for all processes.

config KSU_SUSFS_ENABLE_LOG
	bool "Enable SUSFS kernel logging"
	depends on KSU_SUSFS
	default y
	help
	  Print SUSFS logs to the kernel log buffer.

config KSU_SUSFS_HIDE_KSU_SUSFS_SYMBOLS
	bool "Hide ksu and susfs symbols from /proc/kallsyms"
	depends on KSU_SUSFS
	default y
	help
	  Filter KernelSU and SUSFS symbols from kallsyms output.

config KSU_SUSFS_SPOOF_CMDLINE_OR_BOOTCONFIG
	bool "Enable /proc cmdline or bootconfig spoofing"
	depends on KSU_SUSFS
	default y
	help
	  Spoof /proc/cmdline or /proc/bootconfig with user-defined content.

config KSU_SUSFS_OPEN_REDIRECT
	bool "Enable open redirect"
	depends on KSU_SUSFS
	default y
	help
	  Redirect a selected path to a different backing path when opened.

config KSU_SUSFS_SUS_MAP
	bool "Enable proc maps hiding"
	depends on KSU_SUSFS
	default y
	help
	  Hide selected mmap-backed files from proc maps interfaces.

endmenu

config KPM
	bool "Enable SukiSU KPM"
	depends on KSU && 64BIT
	default n
	help
	  Enabling this option will activate the KPM feature of SukiSU.
	  This option is suitable for scenarios where you need to force KPM to be enabled.
	  but it may affect system stability.
	select KALLSYMS
	select KALLSYMS_ALL

config KSU_DISABLE_MANAGER
	bool "Disable KernelSU manager integration"
	depends on KSU
	default n
	help
	  Disable manager APK detection and manager-specific handling.
	  Root will be used in place of manager-only functionality.

config KSU_DISABLE_POLICY
	bool "Disable KernelSU policy profiles"
	depends on KSU
	default n
	help
	  Disable per-app root/non-root profile customization.
	  Escalation will always use the default full root profile, and
	  non-root handling will follow the global umount policy only.

endmenu
```

## custom_defconfigs/droidspaces_defconfig
```kconfig
# Minimal Droidspaces Support
# Copyright (C) 2025 ravindu644 <droidcasts@protonmail.com>

# IPC mechanisms (required for tools that rely on shared memory and IPC namespaces)
CONFIG_SYSCTL=y
CONFIG_SYSVIPC=y
CONFIG_POSIX_MQUEUE=y

# Core namespace support (essential for assigning PID 1 and running any init system)
CONFIG_NAMESPACES=y
CONFIG_PID_NS=y
CONFIG_UTS_NS=y
CONFIG_IPC_NS=y
CONFIG_MNT_NS=y  # Primarily needed for older kernels (3.x)

# Control groups support (required for systemd)
CONFIG_CGROUPS=y
CONFIG_CGROUP_DEVICE=y
CONFIG_MEMCG=y

# Device filesystem support (enables hardware access when --hw-access is enabled)
CONFIG_DEVTMPFS=y

# Firmware loading support (optional, used when --hw-access is enabled)
CONFIG_FW_LOADER=y
CONFIG_FW_LOADER_USER_HELPER=y
CONFIG_FW_LOADER_COMPRESS=y
```

## kernel-5.10/arch/arm64/configs/lego_defconfig
```kconfig
CONFIG_SEC_PANEL_NOTIFIER_V2=m
CONFIG_USB_TYPEC_MANAGER_NOTIFIER=m
CONFIG_IF_CB_MANAGER=m
# CONFIG_SECURITY_DEFEX is not set
CONFIG_INPUT_SEC_INPUT=m
CONFIG_INPUT_SEC_NOTIFIER=m
CONFIG_SEC_DEBUG_TSP_LOG=m
CONFIG_TOUCHSCREEN_DUMP_MODE=m
CONFIG_SEC_INPUT_HEADER=y
# CONFIG_INPUT_SEC_SECURE_TOUCH is not set
# CONFIG_INPUT_SEC_TRUSTED_TOUCH is not set
# CONFIG_INPUT_TOUCHSCREEN_TCLMV2 is not set
# CONFIG_SEC_INPUT_MULTI_DEVICE is not set
# CONFIG_SEC_INPUT_RAWDATA is not set
CONFIG_MUIC_NOTIFIER=m
CONFIG_VBUS_NOTIFIER=m
CONFIG_HICCUP_CC_DISABLE=y
CONFIG_HICCUP_CHARGER=y
CONFIG_MUIC_AFC_RETRY=y
CONFIG_MUIC_HV=y
CONFIG_MUIC_SUPPORT_PDIC=y
CONFIG_MUIC_USE_MODULE_PARAM=y
CONFIG_USE_MUIC=y
CONFIG_ANDROID_SWITCH=m
# CONFIG_ANDROID_SWITCH_GPIO is not set
CONFIG_SEC_VIBRATOR=m
CONFIG_SEC_VIB_NOTIFIER=y
CONFIG_IIO=y
CONFIG_IIO_BUFFER=y
CONFIG_SHUB=m
CONFIG_SEC_NFC_LOGGER=y
# CONFIG_SECURITY_DSMS is not set
CONFIG_DEV_RIL_BRIDGE=m
CONFIG_SUPPORT_DROPDUMP=m
CONFIG_VIBRATOR_VIB_INFO=m
CONFIG_SEC_STI=y
CONFIG_ZRAM=m
CONFIG_SEC_INPUT_BOOSTER=m
# CONFIG_SEC_INPUT_BOOSTER_MODE is not set
CONFIG_SEC_INPUT_BOOSTER_MTK=y
CONFIG_SEC_INPUT_BOOSTER_HANDLER=y
CONFIG_SB_CORE=m
CONFIG_SB_PQUEUE=y
CONFIG_SB_NOTIFY=y
CONFIG_SB_SYSFS=y
CONFIG_SB_VOTE=y
CONFIG_USB_NOTIFY_LAYER=m
CONFIG_USB_DEBUG_DETAILED_LOG=y
CONFIG_USB_EXTERNAL_NOTIFY=y
CONFIG_USB_HMT_SAMSUNG_INPUT=y
CONFIG_USB_HOST_NOTIFY=y
CONFIG_USB_HOST_SAMSUNG_FEATURE=y
CONFIG_USB_HW_PARAM=y
CONFIG_USB_INTERFACE_LPM_LIST=y
CONFIG_USB_NOTIFY_PROC_LOG=y
CONFIG_USB_USING_ADVANCED_USBLOG=y
CONFIG_USDM_PANEL_OLED_COMMON=m
CONFIG_USDM_PANEL_S6E8FC3=m
CONFIG_SENSORS_FINGERPRINT=m
CONFIG_CHARGER_SM5714=m
CONFIG_SHIPMODE_BY_VBAT=y
CONFIG_SEC_ABC_SPEC_TYPE1=m
CONFIG_PDIC_NOTIFIER=m
CONFIG_PDIC_USE_MODULE_PARAM=y
CONFIG_DRM_PANEL_MCD_COMMON=m
# CONFIG_DRM_PANEL_SAMSUNG_COMMON is not set
CONFIG_USDM_PANEL_JSON=y
CONFIG_SHUB_MODULE=y
CONFIG_SHUB_AP_STATUS_CMD=y
CONFIG_SHUB_MTK=y
CONFIG_USB_NOTIFIER=m
CONFIG_SEC_ABC=m
CONFIG_SEC_ABC_HUB=m
CONFIG_SEC_ABC_COMMON=m
CONFIG_SEC_ABC_HUB_CORE=m
CONFIG_SEC_ABC_HUB_BOOTC=m
CONFIG_SEC_ABC_MOTTO=m
CONFIG_FUELGAUGE_SM5714=m
CONFIG_UI_SOC_PROLONGING=y
CONFIG_REGULATOR_S2MPB03=m
CONFIG_I2C_GPIO=m
CONFIG_SEC_PM_THERMISTOR=m
CONFIG_BATTERY_AUTH_DS28E30=m
CONFIG_CHARGER_SM5461=m
CONFIG_MFD_SM5714=m
CONFIG_MST_LDO=m
CONFIG_MST_ARCH_MTK=y
CONFIG_MST_TEEGRIS=y
CONFIG_MST_DUMMY_DRV=y
CONFIG_BATTERY_AUTH_SLE956681=m
CONFIG_SENSORS_EC6XX=m
CONFIG_SENSORS_FINGERPRINT_MODULE=y
CONFIG_FINGERPRINT_SECURE=y
CONFIG_SENSORS_FINGERPRINT_MTK=y
CONFIG_REGULATOR_FIXED_VOLTAGE=y
CONFIG_MUIC_SM5714=m
CONFIG_MUIC_BCD_RESCAN=y
CONFIG_DIRECT_CHARGING=m
CONFIG_STAR_K250A_LEGO=m
CONFIG_SEC_SNVM_PLATFORM_DRV=y
CONFIG_SEC_SNVM_I2C_CLOCK_CONTROL=y
CONFIG_SEC_SNVM_WAKELOCK_METHOD=2
# CONFIG_STAR_MEMORY_LEAK is not set
CONFIG_DC_VIBRATOR=m
# CONFIG_MTK_VIBRATOR is not set
CONFIG_SENSORS_SX9385=m
# CONFIG_SENSORS_SX9385_SUB is not set
# CONFIG_SENSORS_SX9385_SUB2 is not set
CONFIG_SENSORS_GRIP_FAILURE_DEBUG=y
CONFIG_SENSORS_IRQ_PROCESSING_DELAY=y
CONFIG_MULTI_CHANNEL=y
CONFIG_TOUCHSCREEN_FTS_FT3519=m
CONFIG_PDIC_SM5714=m
CONFIG_SM5714_FACTORY_MODE=y
CONFIG_SUPPORT_USB_TYPEC_OPS=y
CONFIG_SAMSUNG_NFC=m
CONFIG_SEC_MX_NFC=y
CONFIG_MTK_NFC_CLKBUF_ENABLE=y
CONFIG_MTK_CLKBUF_NFC=y
CONFIG_SEC_NFC_WAKELOCK_METHOD=2
# CONFIG_SEC_NFC_DUPLICATED_IRQ_WQ is not set
# CONFIG_SEC_NFC_TEST_ON_PROBE is not set
# CONFIG_ESE_P3_LSI is not set
# CONFIG_ESE_COLDRESET is not set
# CONFIG_ESE_USE_REGULATOR is not set
# CONFIG_MAKE_NODE_USING_PLATFORM_DEVICE is not set
CONFIG_BATTERY_SAMSUNG=m
CONFIG_SEC_PD=m
CONFIG_BATTERY_GKI=y
CONFIG_BATTERY_AGE_FORECAST=y
CONFIG_BATTERY_CISD=y
CONFIG_AFC_CHARGER_MODE=y
CONFIG_BATTERY_AUTH_EUR_DET_GPIO_SUPPORT=y
CONFIG_BATTERY_LOGGING=y
CONFIG_ENABLE_FULL_BY_SOC=y
CONFIG_STEP_CHARGING=y
CONFIG_SUPPORT_HV_CTRL=y
```

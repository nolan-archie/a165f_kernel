#include <dt-bindings/clock/mt6789-clk.h>


/* /home/dpi/qb5_8814/workspace/P4_1716/android/kernel/kmodule/ap/mtk/mt6789/ap_mtk_mt6789.a16_eur.03.dtsi */
#include "../../mediatek/k6789v1_64_titan_whitedragon_24u/Board_00.dts"
#include "../../mediatek/k6789v1_64_titan_whitedragon_24u/gpio03.dtsi"

#define topckgen topckgen_clk
#define infracfg_ao infracfg_ao_clk

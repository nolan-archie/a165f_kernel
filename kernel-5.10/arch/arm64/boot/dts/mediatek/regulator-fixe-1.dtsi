/* 
 * This pinctrl code is only for PULL state change.
 * IN-OUT setting is set to OUTPUT at fixed-regulator probe.
 */

&pio {
        ldo_gpio1: ldo_gpio1 {
#if 1
		GPIO_CONFIG_PUD(AP,pio,152, FUNC_OUTPUT_HIGH, PULL_NONE);
#else
		GPIO_CONFIG_PUD(AP,pio,152, FUNC_OUTPUT_HIGH, PULL_NONE);
#endif
#if 0
		samsung,pin-con-pdn = <3>;
		samsung,pin-pud-pdn = <0>;
#endif
#if 1
		
#endif
        };
};

&smd {
	fixed_regulator1: fixed_regulator@1 {
		compatible = "regulator-fixed";
#if 1
		regulator-name = "lcd_vdd3";
#else
		regulator-name = "fixed_regulator1";
#endif
		gpio = <SEC_GPIO_REF(AP,pio,152) 0>;
		pinctrl-names = "default";
		pinctrl-0 = <&ldo_gpio1>;
		enable-active-high;
	};
};

